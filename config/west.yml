## config/west.yml
```yaml
manifest:
  remotes:
  - name: zmkfirmware
    url-base: https://github.com/zmkfirmware
  - name: lynnlee0522
    url-base: https://github.com/lynnlee0522
  - name: nxtkb
    url-base: https://github.com/nxtkb
  projects:
  - name: zmk
    remote: zmkfirmware
    revision: cb615aee9a7c427e251f2ab62080c1a44a165da9
    import: app/west.yml
  - name: zmk-vfx-sweep-pro-display
    remote: nxtkb
    revision: 6bfacb8bb5e7afb6a8ceb408c85306537be717e5
  - name: zmk-behavior-report
    remote: nxtkb
    revision: main
    import: west.yml
  - name: cirque-input-module
    remote: nxtkb
    revision: main
  self:
    path: config
```
